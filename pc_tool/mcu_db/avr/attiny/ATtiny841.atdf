# ATtiny841 device description
Architecture: AVR8; Family: tinyAVR
Programming and debug interfaces: ISP, HVSP, debugWIRE
Registers are 8-bit, access not given, no defined reset value unless marked. A register's access mark holds for its fields unless they carry their own. Offsets are from the block's base; lines under a group give offsets from that group; [hi:lo] are bit positions; {n}, {i} and the like mark numbered series; 'fields as' and 'values as' point back to an identical list; <NAME> marks a mode.

## Ordering variants
ATtiny841-SSU: SOIC14, pinout SOIC_14, up to 16 MHz, -40 to 85 C, 1.7 to 5.5 V
ATtiny841-MU: MLF20, pinout QFN_20, up to 16 MHz, -40 to 85 C, 1.7 to 5.5 V
ATtiny841-MMH: VQFN20, pinout QFN_20, up to 16 MHz, -40 to 85 C, 1.7 to 5.5 V

## Memory
prog space: start 0x0000 size 0x2000, little endian
  0x0000 FLASH size 0x2000 flash, rw, executable, page 0x10
signatures space: start 0 size 3, little endian
  0 SIGNATURES size 3 signatures, ro
fuses space: start 0 size 0x0003, little endian
  0 FUSES size 0x0003 fuses, rw
lockbits space: start 0 size 0x0001, little endian
  0 LOCKBITS size 0x0001 lockbits, rw
data space: start 0x0000 size 0x0300, little endian
  0x0000 REGISTERS size 0x0020 regs
  0x0020 MAPPED_IO size 0x00e0 io
  0x0100 IRAM size 0x0200 ram
eeprom space: start 0x0000 size 0x0200, little endian
  0x0000 EEPROM size 0x0200 eeprom, rw, page 0x04
io space: start 0x00 size 0x40, little endian
osccal space: start 0 size 2, little endian
  0 OSCCAL size 2 osccal, ro

## Peripheral instances (address, pins/pin function, parameters)
PORTB at 0x00 — I/O Port
  pins: P0 PB0; P1 PB1; P2 PB2; P3 PB3
PORTA at 0x00 — I/O Port
  pins: P{n} PA{n} (n=0..7)
USART1 at 0x00 — USART
  pins: RXD PA4; TXD PA5; XCK PA6
USART0 at 0x00 — USART
  pins: TXD PA1 or PA7/USART_ALT; RXD PA2 or PB2/USART_ALT; XCK PA3 or PA3/USART_ALT
  pin routing set by: U0MAP
WDT at 0x00 — Watchdog Timer
TWI at 0x00 — Two Wire Serial Interface
  pins: SCL PA4; SDA PA6
ADC at 0x00 — Analog-to-Digital Converter
  pins: ADC{n} PA{n} (n=0..7); ADC8 PB2; ADC9 PB3; ADC10 PB0; ADC11 PB1; AREF PA0/AREF
AC at 0x00 — Analog Comparator
  pins: AIN00 PA1/ACIN0; AIN01 PA2/ACIN0; ACO0 PA5/ACOUT; ACO1 PA6/ACOUT; AIN10 PA3/ACIN1; AIN11 PA4/ACIN1
EEPROM at 0x00
TC1 at 0x00 — Timer/Counter, 16-bit
  pins: TOCC0 PA1/OC; TOCC1 PA2/OC; TOCC2 PA3/OC; TOCC3 PA4/OC; TOCC4 PA5/OC; TOCC5 PA6/OC; TOCC6 PA7/OC; TOCC7 PB2/OC; T0 PA3/CS; T1 PA4/CS; T2 PA5/CS; ICP1 PA7/ICP
TC2 at 0x00 — Timer/Counter, 16-bit
  pins: TOCC0 PA1/OC; TOCC1 PA2/OC; TOCC2 PA3/OC; TOCC3 PA4/OC; TOCC4 PA5/OC; TOCC5 PA6/OC; TOCC6 PA7/OC; TOCC7 PB2/OC; T0 PA3/CS; T1 PA4/CS; T2 PA5/CS; ICP2 PB2/ICP
TC0 at 0x00 — Timer/Counter, 8-bit
  pins: TOCC0 PA1/OC or PA2/OC or PA3/OC or PA4/OC or PA5/OC or PA6/OC or PA7/OC or PB2/OC; T0 PA3/CS; T1 PA4/CS; T2 PA5/CS
EXINT at 0x00 — External Interrupts
  pins: PCINT{n} PA{n}/EXTINT (n=0..7); PCINT8 PB0/EXTINT; PCINT9 PB1/EXTINT; PCINT10 PB2/EXTINT; PCINT11 PB3/EXTINT; INT0 PB1/EXTINT
CPU at 0x00 — CPU Registers
  parameters: CORE_VERSION=V2, NEW_INSTRUCTIONS=lpm rd,z+
TOCPM at 0x00 — Timer/Counter Output Compare Pin
SPI at 0x00 — Serial Peripheral Interface
  pins: MISO PA0/SPI_ALT or PA5; MOSI PA1/SPI_ALT or PA6; SS PA2/SPI_ALT or PA7; SCK PA3/SPI_ALT or PA4
  pin routing set by: SPIMAP
FUSE at 0 in fuses — Fuses
LOCKBIT at 0 in lockbits — Lockbits

## Interrupts
0 RESET — External Pin, Power-on Reset, Brown-out Reset and Watchdog Reset
1 INT0 — External Interrupt Request 0
2 PCINT0 — Pin Change Interrupt Request 0
3 PCINT1 — Pin Change Interrupt Request 1
4 WDT — Watchdog Time-out Interrupt
5 TIMER1_CAPT — Timer/Counter1 Capture Event
6 TIMER1_COMPA — Timer/Counter1 Compare Match A
7 TIMER1_COMPB — Timer/Counter1 Compare Match B
8 TIMER1_OVF — Timer/Counter1 Overflow
9 TIMER0_COMPA — TimerCounter0 Compare Match A
10 TIMER0_COMPB — TimerCounter0 Compare Match B
11 TIMER0_OVF — Timer/Counter0 Overflow
12 ANA_COMP0 — Analog Comparator 0
13 ADC — ADC Conversion Complete
14 EE_RDY — EEPROM Ready
15 ANA_COMP1 — Analog Comparator 1
16 TIMER2_CAPT — Timer/Counter2 Capture Event
17 TIMER2_COMPA — Timer/Counter2 Compare Match A
18 TIMER2_COMPB — Timer/Counter2 Compare Match B
19 TIMER2_OVF — Timer/Counter2 Overflow
20 SPI — Serial Peripheral Interface
21 USART0_START
22 USART0_RX — USART0, Rx Complete
23 USART0_UDRE — USART0 Data Register Empty
24 USART0_TX — USART0, Tx Complete
25 USART1_START
26 USART1_RX — USART1, Rx Complete
27 USART1_UDRE — USART1 Data Register Empty
28 USART1_TX — USART1, Tx Complete
29 TWI_SLAVE — Two-wire Serial Interface

## Properties
SIGNATURES: JTAGID=0x9315, SIGNATURE0=0x1e, SIGNATURE1=0x93, SIGNATURE2=0x15
OCD: OCD_REVISION=1, OCD_DATAREG=0x27, PROGBASE=0x0000, BUFFERS_PER_FLASH_PAGE=4

## Pinouts (pin number, pad)
SOIC_14: 14 GND, 13 PA0, 12 PA1, 11 PA2, 10 PA3, 9 PA4, 8 PA5, 7 PA6, 6 PA7, 5 PB2, 4 PB3, 3 PB1, 2 PB0, 1 VCC
QFN_20: 1 PA4, 2 PA3, 3 PA2, 4 PA1, 5 PA0, 8 GND, 9 VCC, 11 PB0, 12 PB1, 13 PB3, 14 PB2, 15 PA7, 16 PA6, 20 PA5
