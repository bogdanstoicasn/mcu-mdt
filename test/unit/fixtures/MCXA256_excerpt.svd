# MCXA256 register map
Vendor: nxp.com; File version: 1.0
Excerpt of NXP MCXA256.svd (FREQME0, VBAT0, FMU0, CTIMER0/1), bitfields removed, for mcu-mdt tests
CPU: CM33 r2p0, little endian, MPU, FPU, VTOR, 3 interrupt priority bits
Registers are 32-bit, read-write, reset 0x0 unless marked. A register's access mark holds for its fields unless they carry their own. Offsets are from the block's base; lines under a group give offsets from that group; [hi:lo] are bit positions; {n}, {i} and the like mark numbered series; 'fields as' and 'values as' point back to an identical list; <NAME> marks a mode.

## Memory map
0x40004000 CTIMER0 size 0x88 — Standard Counter or Timer
0x40005000 CTIMER1 size 0x88 — Standard Counter or Timer
0x40009000 FREQME0 size 0x10 — FREQME
0x40093000 VBAT0 size 0x7FC — VBAT
0x40095000 FMU0 size 0x30 — Flash

## CTIMER0 — Standard Counter or Timer
Base 0x40004000
Same registers: CTIMER1 0x40005000
0x00 IR (reset mask 0xFF) — Interrupt
0x04 TCR (reset mask 0x33) — Timer Control
0x08 TC — Timer Counter
0x0C PR — Prescale
0x10 PC — Prescale Counter
0x14 MCR (reset mask 0xF000FFF) — Match Control
{0x18+4i} MR[{i}] (i=0..3) — Match
0x28 CCR (reset mask 0xFFF) — Capture Control
{0x2C+4i} CR[{i}] (i=0..3) ro — Capture
0x3C EMR (reset mask 0xFFF) — External Match
0x70 CTCR (reset mask 0xFF) — Count Control
0x74 PWMC (reset mask 0xF) — PWM Control
{0x78+4i} MSR[{i}] (i=0..3) — Match Shadow

## FREQME0 — FREQME
Base 0x40009000
0x00 CTRL_R ro (READ_MODE view) — Control (in Read mode)
0x00 CTRL_W wo (WRITE_MODE view) — Control (in Write mode)
0x04 CTRLSTAT — Control Status
0x08 MIN — Minimum
0x0C MAX reset 0x7FFFFFFF — Maximum

## VBAT0 — VBAT
Base 0x40093000
0x00 VERID ro reset 0x1010001 — Version ID
0x200 FROCTLA reset 0x1 — FRO16K Control A
0x218 FROLCKA — FRO16K Lock A
0x220 FROCLKE — FRO16K Clock Enable
{0x700+8i} WAKEUP[{i}] (i=0..1) group — Array of registers: WAKEUPA
  0x00 WAKEUPA — Wakeup 0 Register A
0x7F8 WAKLCKA — Wakeup Lock A

## FMU0 — Flash
Base 0x40095000
0x00 FSTAT reset 0x80 (reset mask 0xFFFFFFFE) — Flash Status Register
0x04 FCNFG (reset mask 0xFFFFFF) — Flash Configuration Register
0x08 FCTRL reset 0x100 (reset mask 0xFFFFFFF0) — Flash Control Register
{0x10+4i} FCCOB{i} (i=0..7) — Flash Common Command Object Registers

## Licence text in the file
Copyright 2016-2024 NXP SPDX-License-Identifier: BSD-3-Clause
